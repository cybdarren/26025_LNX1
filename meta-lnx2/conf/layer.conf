## meta-lnx2/conf/layer.conf
```bitbake
# We have a conf and classes directory, add to BBPATH
BBPATH .= ":${LAYERDIR}"

# We have recipes-* directories, add to BBFILES
BBFILES += "${LAYERDIR}/recipes-*/*/*.bb \
            ${LAYERDIR}/recipes-*/*/*.bbappend"

BBFILE_COLLECTIONS += "meta-lnx2"
BBFILE_PATTERN_meta-lnx2 = "^${LAYERDIR}/"
BBFILE_PRIORITY_meta-lnx2 = "11"

LAYERDEPENDS_meta-lnx2 = "core"
LAYERSERIES_COMPAT_meta-lnx2 = "scarthgap"

MACHINE = "sama7d65-curiosity-sd"
IMAGE_INSTALL:append = " nano"
EXTRA_IMAGE_FEATURES:append = " tools-debug"
```
